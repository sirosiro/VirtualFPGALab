/dts-v1/;

/ {
    /* 
     * The node name 'vfpga_reg' is used as the Shared Memory name (/dev/shm/vfpga_reg)
     */
    vfpga_reg@40000000 {
        compatible = "generic-uio";
        reg = <0x40000000 0x1000>;
        label = "/dev/fpga0";
        
        registers = 
            "RST @ 0x10",
            "EN  @ 0x14",
            "CNT @ 0x18";
    };

    i2c1: i2c@e0004000 {
        compatible = "cdns,i2c-r1p10";
        reg = <0xe0004000 0x1000>;
        bus_id = <1>;
        label = "/dev/i2c-1";
    };
};
