/dts-v1/;

/ {
    /* 
     * 【解説: I2Cバス1の定義】
     * ベースアドレス 0xe0004000 にある Cadence I2C コントローラを定義します。
     */
    i2c1: i2c@e0004000 {
        compatible = "cdns,i2c-r1p10";
        reg = <0xe0004000 0x1000>;
        /* 【解説】 Linuxカーネル内でのバス番号を指定します */
        bus_id = <1>;
        /* 【解説】 アプリケーションが使用するデバイスファイル名 (/dev/i2c-1) */
        label = "/dev/i2c-1";
    };

    /* 
     * 【解説: I2Cバス2の定義】
     * 物理的に別の場所にある、もう一つの I2C コントローラを定義します。
     */
    i2c2: i2c@e0005000 {
        compatible = "cdns,i2c-r1p10";
        reg = <0xe0005000 0x1000>;
        bus_id = <2>;
        label = "/dev/i2c-2";
    };
};
