/dts-v1/;

/ {
    /* Node used for /dev/mem intercept testing */
    vfpga_reg@40000000 {
        compatible = "generic-uio";
        reg = <0x40000000 0x1000>;
        
        registers = 
            "RST @ 0x10",
            "EN  @ 0x14",
            "CNT @ 0x18";
    };
};
